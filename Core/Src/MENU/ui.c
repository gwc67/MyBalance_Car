#include "ui.h"


const uint8_t IMG_Setting[] = {
    0x00,0x00,0x00,0x00,0x00,0xE0,0xF0,0xF8,0xF8,0x7C,0x3C,0x3E,0x3E,0x7E,0x78,0x78,
    0x78,0x78,0x7E,0x3E,0x3E,0x3C,0x7C,0xF8,0xF8,0xF0,0xE0,0x00,0x00,0x00,0x00,0x00,
    0x00,0xF8,0xFC,0xFC,0xFC,0x3F,0x1F,0x0F,0x07,0x80,0xF0,0xF8,0xFC,0x7C,0x3C,0x1E,
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    0x0F,0x1F,0x3E,0x7E,0x7C,0x3C,0x3E,0x1F,0x1F,0x0F,0x07,0x00,0x00,0x00,0x00,0x00
};  /* 设置图标-32x32 */

const uint8_t IMG_Photo[] = {
    0x00,0xC0,0xF0,0xF0,0xF0,0x70,0x70,0x70,0x70,0x70,0x70,0x70,0x70,0x70,0x70,0x70,
    0x70,0x70,0x70,0x70,0x70,0x70,0x70,0x70,0x70,0x70,0x70,0xF0,0xF0,0xF0,0xC0,0x00,
    0x00,0xFF,0xFF,0xFF,0xFF,0x00,0x00,0x1E,0xBF,0xFF,0xFF,0x9E,0x80,0x80,0xC0,0xE0,
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    0x0E,0x0E,0x0E,0x0E,0x0E,0x0E,0x0E,0x0E,0x0E,0x0E,0x0E,0x0F,0x0F,0x0F,0x03,0x00
};  /* 图片图标-32x32 */

const uint8_t IMG_Like[] = {
    0x00,0x00,0x80,0xC0,0xE0,0xF0,0xF8,0xFC,0x7C,0x7C,0x7C,0x7C,0xFC,0xF8,0xF0,0xE0,
    0xE0,0xF0,0xF8,0xFC,0x7C,0x7C,0x7C,0xFC,0xFC,0xF8,0xF0,0xE0,0xC0,0x80,0x00,0x00,
    0x00,0xFE,0xFF,0xFF,0xFF,0x03,0x01,0x00,0x00,0x00,0x00,0x00,0x00,0x01,0x03,0x03,
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    0x3C,0x3E,0x1E,0x1F,0x0F,0x0F,0x07,0x03,0x01,0x00,0x00,0x00,0x00,0x00,0x00,0x00
};  /* 喜欢图标-32x32 */

const uint8_t IMG_Choice[] = {
    0x7F,0x01,0x01,0x01,0x01,0x01,0x01,0x00,0x00,0x00,0x00,0x00,0x00,0x00,0x00,0x00,
    0x00,0x00,0x00,0x00,0x00,0x00,0x00,0x00,0x00,0x01,0x01,0x01,0x01,0x01,0x01,0x7F,
    0x00,0x00,0x00,0x00,0x00,0x00,0x00,0x00,0x00,0x00,0x00,0x00,0x00,0x00,0x00,0x00,
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    0x00,0x00,0x00,0x00,0x00,0x00,0x00,0x00,0x00,0x80,0x80,0x80,0x80,0x80,0x80,0xFE
};  /* 选择框-32x32 */

const uint8_t IMG_Folder[] = {
    0xFF,0xA9,0xB9,0x93,0xA2,0xA2,0x82,0xFE
};  /* 文件夹-8x8 */

const uint8_t IMG_File[] = {
    0x00,0xFF,0x81,0x81,0x83,0x83,0xFE,0x00
};  /* 文件-8x8 */


// void show_Folder8x8_UI(int16_t x ,int16_t y)
// {
//     tft180_Buffer_Image(x,y,8,8,IMG_Folder);
// }

// void show_File8x8_UI(int16_t x ,int16_t y)
// {
//     tft180_Buffer_Image(x,y,8,8,IMG_File);
// }


void cartoon_move_ui(UI_* ui, uint8_t spd)
{
    if (ui->base.x == ui->base.tarX && ui->base.y == ui->base.tarY)
    {
        return;
    }
    int8_t stepx;
    int8_t stepy;
    int8_t th = spd;
    if (abs(ui->base.tarX -  ui->base.x) > th)
    {
        stepx = (ui->base.tarX - ui->base.x) / th;
    }
    else
    {
        stepx = ( ui->base.tarX -  ui->base.x> 0)? 1 : (ui->base.tarX -  ui->base.x < 0)? -1 : 0;
    }
    if (abs(ui->base.tarY - ui->base.y )> th)
    {
        stepy = (ui->base.tarY - ui->base.y) / th;
    }
    else
    {
        stepy = (ui->base.tarY - ui->base.y > 0)? 1 : (ui->base.tarY - ui->base.y < 0)? -1 : 0;
    }
    
    ui->base.x += stepx;
    ui->base.y += stepy;

}

void cartoon_zoom_ui(UI_* ui, uint8_t spd)
{
    if (ui->state != UI_BASE_IMG)
    {
        return;
    }
    if (ui->IMG.high == ui->IMG.tarHigh && ui->IMG.wide == ui->IMG.tarWide)
    {
        return;
    }

    int8_t stepx;
    int8_t stepy;
    int8_t th = spd;

    if (abs(ui->IMG.tarWide -  ui->IMG.wide) > th)
    {
        stepx = (ui->IMG.tarWide -  ui->IMG.wide) / th;
    }
    else{
        stepx = (ui->IMG.tarWide -  ui->IMG.wide > 0)? 1: (ui->IMG.tarWide - ui->IMG.wide < 0)? -1 : 0;
    }
    if (abs(ui->IMG.tarHigh - ui->IMG.high) > th)
    {
        stepy = (ui->IMG.tarHigh - ui->IMG.high ) / th;
    }
    else{
        stepy = (ui->IMG.tarHigh - ui->IMG.high > 0)? 1: (ui->IMG.tarHigh - ui->IMG.high < 0)? -1 : 0;
    }
    
    ui->IMG.wide += stepx;
    ui->IMG.high += stepy;
}

void set_ui_tarXY(int16_t x, int16_t y , UI_* ui)
{
    ui->base.tarX = x;
    ui->base.tarY = y;
}

void set_ui_tarHW(int16_t h,int16_t w,UI_* ui)
{
    ui->IMG.tarHigh = h;
    ui->IMG.tarWide = w;
}

void show_cursor_UI(UI_* cursor)
{
    OLED_ReverseArea(cursor->base.x,cursor->base.y,cursor->IMG.high,cursor->IMG.wide);
}